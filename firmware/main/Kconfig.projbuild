## firmware/main/Kconfig.projbuild
```kconfig
menu "Onurb"

    config ONURB_WIFI_SSID
        string "Wi-Fi SSID (2.4 GHz)"
        default "CHANGE_ME_SSID"
        help
            Placeholder in git. Set the real value locally (sdkconfig is gitignored).

    config ONURB_WIFI_PASSWORD
        string "Wi-Fi password"
        default "CHANGE_ME_PASSWORD"

    config ONURB_API_BASE_URL
        string "Gateway base URL"
        default "http://192.168.1.100:8080"
        help
            Onurb gateway (docs/AGENT.md). Placeholder in git; set locally.

    config ONURB_API_REMOTE_URL
        string "Remote gateway URL (server, HTTPS; empty = none)"
        default ""
        help
            docs/SERVER.md. Used when the local gateway can't be reached. Set locally.

    config ONURB_CF_ACCESS_ID
        string "Cloudflare Access service token: client id"
        default ""

    config ONURB_CF_ACCESS_SECRET
        string "Cloudflare Access service token: client secret"
        default ""

    config ONURB_API_TOKEN
        string "Gateway bearer token (empty = none)"
        default ""

    config ONURB_ALLOW_PLAIN_HTTP
        bool "Allow plain http:// (LAN gateway / mock only)"
        default y

    config ONURB_BUTTON_GPIO
        int "Push-to-talk button GPIO"
        default 0
        help
            BOOT button = GPIO0 (active low). Do not use GPIO35 (unverified claim).

    config ONURB_VOLUME
        int "Speaker volume (0-100)"
        range 0 100
        default 60

    config ONURB_SCREEN_BRIGHTNESS
        int "Screen brightness (%)"
        range 0 100
        default 50

    config ONURB_SCREEN_IDLE_S
        int "Turn the screen off after this many idle seconds"
        range 1 600
        default 5

    config ONURB_MIC_GAIN_DB
        int "ES7210 input gain (dB)"
        range 0 37
        default 24


    choice ONURB_CHARGE_CURRENT
        prompt "Battery charge current (AXP2101 constant-current phase)"
        default ONURB_CHARGE_CURRENT_200MA
        help
            The kit's cell is 400 mAh. 200 mA (0.5C) is gentler and cooler;
            400 mA (1C) matches Waveshare's 01_AXP2101 example.

        config ONURB_CHARGE_CURRENT_200MA
            bool "200 mA"
        config ONURB_CHARGE_CURRENT_400MA
            bool "400 mA"
    endchoice

    config ONURB_OTA_CHECK_MIN
        int "Minutes between Wi-Fi update checks"
        range 1 1440
        default 60
        help
            The watch also checks once right after boot. Updates come from
            ONURB_API_BASE_URL/v1/firmware (served by the gateway).

endmenu
```
